// SPDX-License-Identifier: (GPL-2.0+ OR MIT)
/* 
 * Enable the Blue Gecko chip (EFR32BG22) in the Futurehome cube-2v0-eu by
 * supplying power to it. Split out to an overlay because it might not
 * be desirable to automatically enable the chip on boot in all scenarios.
 */

/dts-v1/;
/plugin/;

#include <dt-bindings/gpio/gpio.h>
#include <dt-bindings/pinctrl/rockchip.h>

/ {
    fragment@0 {
        target = <&onboard_efr32bg22>;
        __overlay__ {
            enable-active-high;
            gpio = <&gpio2 RK_PC1 GPIO_ACTIVE_HIGH>;
            pinctrl-0 = <&onboard_efr32bg22_powered>,
					    <&onboard_efr32bg22_reset>;
        };
    };
};
